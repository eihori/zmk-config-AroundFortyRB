## config/west.yml
```yaml
manifest:
  remotes:
    - name: zmkfirmware
      url-base: https://github.com/zmkfirmware
    - name: razilyis
      url-base: https://github.com/razilyis
    - name: caksoylar
      url-base: https://github.com/caksoylar
  projects:
    - name: zmk
      remote: zmkfirmware
      revision: f9be3ed
      import: app/west.yml
    - name: zmk-pmw3610-driver
      remote: razilyis
      revision: 2618e8550876e4a3e06215bf0138c4c424d0398b
    - name: zmk-rgbled-widget
      remote: caksoylar
      revision: main
  self:
    path: config
```
